## meta-simpleboot/conf/distro/simpleboot.conf
```bitbake
DISTRO = "simpleboot"
DISTRO_NAME = "simpleboot"
DISTRO_VERSION = "1.0"
DISTRO_CODENAME = "none"

# TCLIBC = "musl"
TCLIBC = "glibc"

require conf/distro/include/no-static-libs.inc
require conf/distro/include/security_flags.inc

INHERIT += "image-buildinfo"
IMAGE_BUILDINFO_VARS += " LAYERSERIES_CORENAMES"

GLIBC_GENERATE_LOCALES = "en_US.UTF-8"
IMAGE_LINGUAS ?= "en-us"

# No hostname
hostname:simpleboot = "simpleboot"

# disable some features
DISTRO_FEATURES:remove = " x11 alsa zeroconf 3g nfc pcmcia irda bluetooth nfs vulkan "
DISTRO_FEATURES:append = " largefile usrmerge "

# prevent kernel image from being embedded in rootfs
RRECOMMENDS:${KERNEL_PACKAGE_NAME}-base = ""

# no init system
VIRTUAL-RUNTIME_initscripts = ""
VIRTUAL-RUNTIME_init_manager = ""
DISTRO_FEATURES_BACKFILL_CONSIDERED = "sysvinit"

# prevent all debug-tweaks
EXTRA_IMAGE_FEATURES:remove = "debug-tweaks"
IMAGE_FEATURES:append = " empty-root-password "
# cut out some packages that are useless on a initramfs
IMAGE_FEATURES:append = " read-only-rootfs "

# ensure the image is built with cpio.gz
IMAGE_FSTYPES = " cpio cpio.gz cpio.zst tar.gz "
IMAGE_NAME_SUFFIX ?= ""
INITRAMFS_IMAGE = "flash-rootfs-image"
INITRAMFS_IMAGE_BUNDLE = "1"

# tiny kernel configuration for size reasons
PREFERRED_PROVIDER_virtual/kernel = "linux-mainline-simpleboot"
# PREFERRED_PROVIDER_virtual/kernel = "linux-yocto-tiny"
```

## meta-simpleboot/conf/layer.conf
```bitbake
# We have a conf and classes directory, add to BBPATH
BBPATH .= ":${LAYERDIR}"

BBFILES += "${LAYERDIR}/recipes-bsp/*/*.bb"
BBFILES += "${LAYERDIR}/recipes-bsp/*/*.bbappend"
BBFILES += "${LAYERDIR}/recipes-kernel/*/*.bb"
BBFILES += "${LAYERDIR}/recipes-kernel/*/*.bbappend"
BBFILES += "${LAYERDIR}/recipes-simpleboot/*/*.bb"
BBFILES += "${LAYERDIR}/recipes-simpleboot/*/*.bbappend"

BBFILE_COLLECTIONS += "simpleboot"
BBFILE_PATTERN_simpleboot = "^${LAYERDIR}/"
BBFILE_PRIORITY_simpleboot = "6"

LAYERDEPENDS_simpleboot = "core"
LAYERSERIES_COMPAT_simpleboot = "whinlatter"
```
